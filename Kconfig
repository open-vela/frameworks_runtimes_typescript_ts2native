## Kconfig
```kconfig
#
# For a description of the syntax of this configuration file,
# see the file kconfig-language.txt in the NuttX tools repository.
#

config EXAMPLES_TSSHELL
	tristate "\"ts shell\" example"
	default n
	---help---
		Enable the \"ts shell\" example

if EXAMPLES_TSSHELL

config EXAMPLES_TSSHELL_PROGNAME
	string "Program name"
	default "tsshell"
	---help---
		This is the name of the program that will be used when the NSH ELF
		program is installed.

config EXAMPLES_TSSHELL_PRIORITY
	int "ts shell task priority"
	default 100

config EXAMPLES_TSSHELL_STACKSIZE
	int "ts shell stack size"
	default DEFAULT_TASK_STACKSIZE

endif
```
